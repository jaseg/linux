## Documentation/devicetree/bindings/display/gdepaper.txt
```
Good Display/Waveshare e-ink displays

Required properties:
- compatible:		"gddsp,wfi0190cz22" for 2.7" b/w/red displays

- dc-gpios:		Data Command
- reset-gpios:		Reset pin
- busy-gpios:		Busy pin

The node for this driver must be a child node of a SPI controller, hence
all mandatory properties described in ../spi/spi-bus.txt must be specified.

Example:

	waveshare27b@0{
		compatible = "gddsp,wfi0190cz22";
		reg = <0>;

		spi-max-frequency = <8000000>;

		dc-gpios = <&gpio 25 1>;
		reset-gpios = <&gpio 17 1>;
		busy-gpios = <&gpio 24 0>;
	};
```
