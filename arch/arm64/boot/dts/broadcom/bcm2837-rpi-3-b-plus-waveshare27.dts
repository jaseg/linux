// SPDX-License-Identifier: GPL-2.0
/dts-v1/;
#include "bcm2837-rpi-3-b-plus.dts"

&spi {
        pinctrl-names = "default";
        pinctrl-0 = <&spi0_gpio7>;
        status = "okay";

        spidev@0 {
                status = "disabled";
        };

        spidev@1 {
                status = "disabled";
        };

        waveshare27b@0 { 
                compatible = "gddsp,wfi0190cz22";
                reg = <0>;
                spi-max-frequency = <1000000>;
                dc-gpios = <&gpio 25 GPIO_ACTIVE_HIGH>;
                reset-gpios = <&gpio 17 GPIO_ACTIVE_HIGH>;
                busy-gpios = <&gpio 24 GPIO_ACTIVE_LOW>;
		dimensions-px = <176 264>;
		dimensions-mm = <38 57>;
		colors = <1>;
        };
};
